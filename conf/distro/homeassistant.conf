## conf/distro/homeassistant.conf
```bitbake
# Generic information
################################
DISTRO = "homeassistant"
DISTRO_NAME = "HomeAssistant Linux Distro"
DISTRO_VERSION = "1.0.0"
DISTRO_CODENAME = "homeassistant"
MAINTAINER = "Tom Geelen <t.f.g.geelen@gmail.com>"
TARGET_VENDOR = "-homeassistant"

# SDK information
#################################
SDK_VENDOR = "-homeassistantsdk"
SDK_VERSION = "${@d.getVar('DISTRO_VERSION').replace('snapshot-${METADATA_REVISION}', 'snapshot')}"
SDK_VERSION[vardepvalue] = "${SDK_VERSION}"
SDK_MACHINE = "x86_64"  
SDK_NAME = "${DISTRO}-${TCLIBC}-${SDKMACHINE}-${IMAGE_BASENAME}-${TUNE_PKGARCH}-${MACHINE}"
SDKPATHINSTALL = "/opt/${DISTRO}/${SDK_VERSION}"

# Distro features
#################################
DISTRO_FEATURES = "\
"

# Image settings
###############################
# Prevent stacking up old builds and do not symlink everything
IMAGE_VERSION_SUFFIX = "-${DISTRO_VERSION}"
IMAGE_NAME_SUFFIX = ""
INIT_MANAGER = "systemd"

# Package settings
################################
PACKAGE_CLASSES = "package_rpm"

FORTRAN:forcevariable = ",fortran"
RUNTIMETARGET:append:pn-gcc-runtime = " libquadmath"
HOSTTOOLS += "gfortran"

# Kernel features
################################
# We need debug symbols so that SPDX license manifests for the kernel work
KERNEL_EXTRA_FEATURES:append = " features/debug/debug-kernel.scc"

# License settings
#################################
LICENSE_FLAGS_ACCEPTED = "\
    commercial_ffmpeg \
    commercial_libheif \
    commercial_python3-pillow-heif \
    commercial_libde265 \
    commercial_openh264 \
    commercial_x265 \
"
```
